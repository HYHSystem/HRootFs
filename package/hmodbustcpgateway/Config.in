## package/hmodbustcpgateway/Config.in
```kconfig
comment "hmodbustcpgateway needs a toolchain w/ C++, wchar, dynamic library, threads"
	depends on !BR2_INSTALL_LIBSTDCPP || !BR2_USE_WCHAR || \
		BR2_STATIC_LIBS || !BR2_TOOLCHAIN_HAS_THREADS

config BR2_PACKAGE_HMODBUSTCPGATEWAY
	bool "hmodbustcpgateway"
	depends on !BR2_STATIC_LIBS
	depends on BR2_USE_WCHAR
	depends on BR2_INSTALL_LIBSTDCPP
	depends on BR2_TOOLCHAIN_HAS_THREADS
	select BR2_PACKAGE_LIBSERIALPORT
	select BR2_PACKAGE_LIBEVENT
	select BR2_PACKAGE_HOST_HMODBUSTCPGATEWAY
	help
	  HCppBox hmodbustcpgateway

	  https://git.hyhsystem.cn/HEYAHONG/HCppBox
```

## package/hmodbustcpgateway/Config.in.host
```kconfig
config BR2_PACKAGE_HOST_HMODBUSTCPGATEWAY
	bool "host hmodbustcpgateway"
	help
	  HCppBox hmodbustcpgateway host tool

	  This tool requires libserialport and libevent installed on the build host.

	  https://git.hyhsystem.cn/HEYAHONG/HCppBox
```

## package/hsimulatortools/Config.in.host
```kconfig
config BR2_PACKAGE_HOST_HSIMULATORTOOLS
	bool "host hsimulatortools"
	help
	  HCppBox hsimulatortools host tool

	  This tool requires wxWidgets 3.2 or later on the build host.

	  https://git.hyhsystem.cn/HEYAHONG/HCppBox
```

## package/hsntp/Config.in
```kconfig
comment "hsntp needs a toolchain w/ C++, wchar, dynamic library, threads"
	depends on !BR2_INSTALL_LIBSTDCPP || !BR2_USE_WCHAR || \
		BR2_STATIC_LIBS || !BR2_TOOLCHAIN_HAS_THREADS

config BR2_PACKAGE_HSNTP
	bool "hsntp"
	depends on !BR2_STATIC_LIBS
	depends on BR2_USE_WCHAR
	depends on BR2_INSTALL_LIBSTDCPP
	depends on BR2_TOOLCHAIN_HAS_THREADS
	select BR2_PACKAGE_HOST_HSNTP
	help
	  HCppBox hsntp

	  https://git.hyhsystem.cn/HEYAHONG/HCppBox
```

## package/hsntp/Config.in.host
```kconfig
config BR2_PACKAGE_HOST_HSNTP
	bool "host hsntp"
	help
	  HCppBox hsntp host tool

	  https://git.hyhsystem.cn/HEYAHONG/HCppBox
```

## package/hsntpd/Config.in
```kconfig
comment "hsntpd needs a toolchain w/ C++, wchar, threads"
	depends on !BR2_INSTALL_LIBSTDCPP || !BR2_USE_WCHAR || \
		!BR2_TOOLCHAIN_HAS_THREADS

config BR2_PACKAGE_HSNTPD
	bool "hsntpd"
	depends on BR2_USE_WCHAR
	depends on BR2_INSTALL_LIBSTDCPP
	depends on BR2_TOOLCHAIN_HAS_THREADS
	select BR2_PACKAGE_HOST_HSNTPD
	help
	  HCppBox hsntpd

	  https://git.hyhsystem.cn/HEYAHONG/HCppBox
```

## package/hsntpd/Config.in.host
```kconfig
config BR2_PACKAGE_HOST_HSNTPD
	bool "host hsntpd"
	help
	  HCppBox hsntpd host tool

	  https://git.hyhsystem.cn/HEYAHONG/HCppBox
```

## package/imageresourcegenerate/Config.in
```kconfig
comment "imageresourcegenerate needs a toolchain w/ C++, wchar, dynamic library, NPTL threads, atomic"
	depends on !BR2_INSTALL_LIBSTDCPP || !BR2_USE_WCHAR || \
		BR2_STATIC_LIBS || !BR2_TOOLCHAIN_HAS_THREADS_NPTL || \
		!BR2_TOOLCHAIN_HAS_ATOMIC

config BR2_PACKAGE_IMAGERESOURCEGENERATE
	bool "imageresourcegenerate"
	depends on BR2_TOOLCHAIN_HAS_ATOMIC
	depends on BR2_TOOLCHAIN_HAS_THREADS_NPTL
	depends on !BR2_STATIC_LIBS
	depends on BR2_USE_WCHAR
	depends on BR2_INSTALL_LIBSTDCPP
	depends on BR2_TOOLCHAIN_GCC_AT_LEAST_4_8 # C++11 (opencv4)
	select BR2_PACKAGE_OPENCV4
	select BR2_PACKAGE_OPENCV4_LIB_IMGCODECS
	select BR2_PACKAGE_HOST_IMAGERESOURCEGENERATE
	help
	  HCppBox imageresourcegenerate

	  https://git.hyhsystem.cn/HEYAHONG/HCppBox
```

## package/imageresourcegenerate/Config.in.host
```kconfig
config BR2_PACKAGE_HOST_IMAGERESOURCEGENERATE
	bool "host imageresourcegenerate"
	help
	  HCppBox imageresourcegenerate host tool

	  This tool requires OpenCV installed on the build host.

	  https://git.hyhsystem.cn/HEYAHONG/HCppBox
```

## package/matiec/Config.in
```kconfig
comment "matiec needs a toolchain w/ C++, gcc >= 7"
	depends on !BR2_INSTALL_LIBSTDCPP || !BR2_TOOLCHAIN_GCC_AT_LEAST_7

config BR2_PACKAGE_MATIEC
	bool "matiec"
	depends on BR2_INSTALL_LIBSTDCPP
	depends on BR2_TOOLCHAIN_GCC_AT_LEAST_7 # C++17
	select BR2_PACKAGE_HOST_MATIEC
	help
	  IEC 61131-3 compiler (matiec)

	  https://github.com/thiagoralves/matiec
```

## package/matiec/Config.in.host
```kconfig
config BR2_PACKAGE_HOST_MATIEC
	bool "host matiec"
	help
	  IEC 61131-3 compiler (matiec) host tool

	  https://github.com/thiagoralves/matiec
```

## package/rvvm/Config.in
```kconfig
comment "rvvm needs a toolchain w/ C++, threads"
	depends on !BR2_INSTALL_LIBSTDCPP || !BR2_TOOLCHAIN_HAS_THREADS

config BR2_PACKAGE_RVVM
	bool "rvvm"
	depends on BR2_INSTALL_LIBSTDCPP
	depends on BR2_TOOLCHAIN_HAS_THREADS
	select BR2_PACKAGE_HOST_RVVM
	help
	  RVVM virtual machine

	  https://github.com/LekKit/RVVM
```

## package/rvvm/Config.in.host
```kconfig
config BR2_PACKAGE_HOST_RVVM
	bool "host rvvm"
	help
	  RVVM virtual machine host tool

	  https://github.com/LekKit/RVVM
```
