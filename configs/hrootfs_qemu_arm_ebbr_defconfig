## configs/hrootfs_qemu_arm_ebbr_defconfig
```kconfig
BR2_arm=y
BR2_cortex_a15=y
BR2_TOOLCHAIN_EXTERNAL=y
BR2_TOOLCHAIN_EXTERNAL_BOOTLIN=y
BR2_TOOLCHAIN_EXTERNAL_BOOTLIN_ARMV7_EABIHF_GLIBC_STABLE=y
BR2_GLOBAL_PATCH_DIR="board/hrootfs/qemu/patches"
BR2_DOWNLOAD_FORCE_CHECK_HASHES=y
BR2_ROOTFS_POST_IMAGE_SCRIPT="board/hrootfs/qemu/post-image.sh board/hrootfs/qemu/arm-ebbr/post-image.sh support/scripts/genimage.sh"
BR2_ROOTFS_POST_SCRIPT_ARGS="$(BR2_DEFCONFIG) -c board/hrootfs/qemu/arm-ebbr/genimage.cfg"
BR2_ENABLE_LOCALE_PURGE=y
BR2_ENABLE_LOCALE_WHITELIST="C en_US zh_CN"
BR2_GENERATE_LOCALE="C en_US zh_CN"
BR2_SYSTEM_ENABLE_NLS=y
BR2_TARGET_TZ_INFO=y
BR2_TARGET_TZ_ZONELIST="default"
BR2_TARGET_LOCALTIME="Asia/Shanghai"
BR2_ROOTFS_OVERLAY="board/hrootfs/qemu/overlay"
BR2_LINUX_KERNEL=y
BR2_LINUX_KERNEL_CUSTOM_VERSION=y
BR2_LINUX_KERNEL_CUSTOM_VERSION_VALUE="6.18.7"
BR2_LINUX_KERNEL_USE_ARCH_DEFAULT_CONFIG=y
BR2_LINUX_KERNEL_CONFIG_FRAGMENT_FILES="board/hrootfs/qemu/arm-ebbr/linux.fragment"
BR2_LINUX_KERNEL_NEEDS_HOST_OPENSSL=y
BR2_LINUX_KERNEL_NEEDS_HOST_PYTHON3=y
BR2_PACKAGE_OPTEE_CLIENT=y
BR2_TARGET_ROOTFS_EXT2=y
BR2_TARGET_ROOTFS_EXT2_4=y
BR2_TARGET_ROOTFS_EXT2_SIZE="200M"
# BR2_TARGET_ROOTFS_TAR is not set
BR2_TARGET_GENERIC_HOSTNAME="HRootFs"
BR2_TARGET_GENERIC_ISSUE="Welcome to HRootFs"
BR2_TARGET_ARM_TRUSTED_FIRMWARE=y
BR2_TARGET_ARM_TRUSTED_FIRMWARE_CUSTOM_VERSION=y
BR2_TARGET_ARM_TRUSTED_FIRMWARE_CUSTOM_VERSION_VALUE="v2.10"
BR2_TARGET_ARM_TRUSTED_FIRMWARE_PLATFORM="qemu"
BR2_TARGET_ARM_TRUSTED_FIRMWARE_FIP=y
BR2_TARGET_ARM_TRUSTED_FIRMWARE_BL32_OPTEE=y
BR2_TARGET_ARM_TRUSTED_FIRMWARE_UBOOT_AS_BL33=y
BR2_TARGET_ARM_TRUSTED_FIRMWARE_ADDITIONAL_VARIABLES="BL32_RAM_LOCATION=tdram"
BR2_TARGET_GRUB2=y
BR2_TARGET_GRUB2_ARM_EFI=y
BR2_TARGET_OPTEE_OS=y
BR2_TARGET_OPTEE_OS_NEEDS_DTC=y
BR2_TARGET_OPTEE_OS_PLATFORM="vexpress-qemu_virt"
BR2_TARGET_UBOOT=y
BR2_TARGET_UBOOT_BUILD_SYSTEM_KCONFIG=y
BR2_TARGET_UBOOT_CUSTOM_VERSION=y
BR2_TARGET_UBOOT_CUSTOM_VERSION_VALUE="2024.01"
BR2_TARGET_UBOOT_BOARD_DEFCONFIG="qemu_arm"
BR2_TARGET_UBOOT_CONFIG_FRAGMENT_FILES="board/hrootfs/qemu/arm-ebbr/u-boot.fragment"
BR2_TARGET_UBOOT_NEEDS_OPENSSL=y
BR2_PACKAGE_HOST_DOSFSTOOLS=y
BR2_PACKAGE_HOST_GENIMAGE=y
BR2_PACKAGE_HOST_MTOOLS=y
BR2_PACKAGE_HOST_QEMU=y
BR2_PACKAGE_HOST_QEMU_SYSTEM_MODE=y
BR2_PACKAGE_KEXEC=y
BR2_PACKAGE_KEXEC_ZLIB=y
BR2_PACKAGE_HASHTOOL=y
BR2_PACKAGE_HOST_HASHTOOL=y
BR2_PACKAGE_HED25519SIGN=y
BR2_PACKAGE_HOST_HED25519SIGN=y
BR2_PACKAGE_HCRCTABLEGENERATE=y
BR2_PACKAGE_HOST_HCRCTABLEGENERATE=y
BR2_PACKAGE_HGZIP=y
BR2_PACKAGE_HOST_HGZIP=y
BR2_PACKAGE_HLZ4=y
BR2_PACKAGE_HOST_HLZ4=y
BR2_PACKAGE_HMINI_MCS51=y
BR2_PACKAGE_HOST_HMINI_MCS51=y
BR2_PACKAGE_HMINI_RV32IMA=y
BR2_PACKAGE_HOST_HMINI_RV32IMA=y
BR2_PACKAGE_HMINI_RV32IMAV2=y
BR2_PACKAGE_HOST_HMINI_RV32IMAV2=y
BR2_PACKAGE_DUMPPLCDLL=y
BR2_PACKAGE_HOST_DUMPPLCDLL=y
BR2_PACKAGE_OPENSSL=y
BR2_PACKAGE_HHTTP=y
BR2_PACKAGE_HOST_HHTTP=y
BR2_PACKAGE_HHTTP_OPENSSL=y
BR2_PACKAGE_HHTTPD=y
BR2_PACKAGE_HOST_HHTTPD=y
BR2_PACKAGE_HHTTPD_OPENSSL=y
BR2_PACKAGE_HSNTP=y
BR2_PACKAGE_HOST_HSNTP=y
BR2_PACKAGE_HSNTPD=y
BR2_PACKAGE_HOST_HSNTPD=y
```

## configs/hrootfs_qemu_arm_vexpress_tz_defconfig
```kconfig
BR2_arm=y
BR2_cortex_a15=y
BR2_ARM_FPU_VFPV3D16=y
BR2_TOOLCHAIN_EXTERNAL=y
BR2_TOOLCHAIN_EXTERNAL_BOOTLIN=y
BR2_TOOLCHAIN_EXTERNAL_BOOTLIN_ARMV7_EABIHF_GLIBC_STABLE=y
BR2_GLOBAL_PATCH_DIR="board/hrootfs/qemu/patches"
BR2_DOWNLOAD_FORCE_CHECK_HASHES=y
BR2_TARGET_GENERIC_GETTY_PORT="ttyAMA0"
BR2_ROOTFS_POST_BUILD_SCRIPT="board/hrootfs/qemu/arm-vexpress-tz/post-build.sh"
BR2_ROOTFS_POST_IMAGE_SCRIPT="board/hrootfs/qemu/post-image.sh"
BR2_ROOTFS_POST_SCRIPT_ARGS="$(BR2_DEFCONFIG)"
BR2_ENABLE_LOCALE_PURGE=y
BR2_ENABLE_LOCALE_WHITELIST="C en_US zh_CN"
BR2_GENERATE_LOCALE="C en_US zh_CN"
BR2_SYSTEM_ENABLE_NLS=y
BR2_TARGET_TZ_INFO=y
BR2_TARGET_TZ_ZONELIST="default"
BR2_TARGET_LOCALTIME="Asia/Shanghai"
BR2_ROOTFS_OVERLAY="board/hrootfs/qemu/overlay"
BR2_LINUX_KERNEL=y
BR2_LINUX_KERNEL_CUSTOM_VERSION=y
BR2_LINUX_KERNEL_CUSTOM_VERSION_VALUE="6.18.7"
BR2_LINUX_KERNEL_DEFCONFIG="vexpress"
BR2_LINUX_KERNEL_CONFIG_FRAGMENT_FILES="board/hrootfs/qemu/arm-vexpress-tz/linux.fragment"
BR2_PACKAGE_OPENSSL=y
BR2_PACKAGE_OPTEE_EXAMPLES=y
BR2_PACKAGE_OPTEE_TEST=y
BR2_TARGET_ROOTFS_CPIO=y
BR2_TARGET_ROOTFS_CPIO_GZIP=y
BR2_TARGET_ROOTFS_CPIO_UIMAGE=y
# BR2_TARGET_ROOTFS_TAR is not set
BR2_TARGET_GENERIC_HOSTNAME="HRootFs"
BR2_TARGET_GENERIC_ISSUE="Welcome to HRootFs"
BR2_TARGET_ARM_TRUSTED_FIRMWARE=y
BR2_TARGET_ARM_TRUSTED_FIRMWARE_LATEST_LTS_2_12_VERSION=y
BR2_TARGET_ARM_TRUSTED_FIRMWARE_PLATFORM="qemu"
BR2_TARGET_ARM_TRUSTED_FIRMWARE_FIP=y
BR2_TARGET_ARM_TRUSTED_FIRMWARE_BL32_OPTEE=y
BR2_TARGET_ARM_TRUSTED_FIRMWARE_UBOOT_AS_BL33=y
BR2_TARGET_ARM_TRUSTED_FIRMWARE_ADDITIONAL_VARIABLES="BL32_RAM_LOCATION=tdram"
BR2_TARGET_OPTEE_OS=y
BR2_TARGET_OPTEE_OS_NEEDS_DTC=y
BR2_TARGET_OPTEE_OS_PLATFORM="vexpress-qemu_virt"
BR2_TARGET_UBOOT=y
BR2_TARGET_UBOOT_BUILD_SYSTEM_KCONFIG=y
BR2_TARGET_UBOOT_CUSTOM_VERSION=y
BR2_TARGET_UBOOT_CUSTOM_VERSION_VALUE="2026.04"
BR2_TARGET_UBOOT_BOARD_DEFCONFIG="qemu_arm"
BR2_TARGET_UBOOT_CONFIG_FRAGMENT_FILES="board/hrootfs/qemu/arm-vexpress-tz/u-boot.config"
BR2_TARGET_UBOOT_NEEDS_DTC=y
BR2_PACKAGE_HOST_QEMU=y
BR2_PACKAGE_HOST_QEMU_SYSTEM_MODE=y
BR2_PACKAGE_KEXEC=y
BR2_PACKAGE_KEXEC_ZLIB=y
BR2_PACKAGE_HASHTOOL=y
BR2_PACKAGE_HOST_HASHTOOL=y
BR2_PACKAGE_HED25519SIGN=y
BR2_PACKAGE_HOST_HED25519SIGN=y
BR2_PACKAGE_HCRCTABLEGENERATE=y
BR2_PACKAGE_HOST_HCRCTABLEGENERATE=y
BR2_PACKAGE_HGZIP=y
BR2_PACKAGE_HOST_HGZIP=y
BR2_PACKAGE_HLZ4=y
BR2_PACKAGE_HOST_HLZ4=y
BR2_PACKAGE_HMINI_MCS51=y
BR2_PACKAGE_HOST_HMINI_MCS51=y
BR2_PACKAGE_HMINI_RV32IMA=y
BR2_PACKAGE_HOST_HMINI_RV32IMA=y
BR2_PACKAGE_HMINI_RV32IMAV2=y
BR2_PACKAGE_HOST_HMINI_RV32IMAV2=y
BR2_PACKAGE_DUMPPLCDLL=y
BR2_PACKAGE_HOST_DUMPPLCDLL=y
BR2_PACKAGE_HHTTP=y
BR2_PACKAGE_HOST_HHTTP=y
BR2_PACKAGE_HHTTP_OPENSSL=y
BR2_PACKAGE_HHTTPD=y
BR2_PACKAGE_HOST_HHTTPD=y
BR2_PACKAGE_HHTTPD_OPENSSL=y
BR2_PACKAGE_HSNTP=y
BR2_PACKAGE_HOST_HSNTP=y
BR2_PACKAGE_HSNTPD=y
BR2_PACKAGE_HOST_HSNTPD=y
```

## configs/hrootfs_qemu_riscv64_virt_defconfig
```kconfig
BR2_riscv=y
BR2_TOOLCHAIN_BUILDROOT_CXX=y
BR2_PACKAGE_HOST_LINUX_HEADERS_CUSTOM_6_18=y
BR2_GLOBAL_PATCH_DIR="board/hrootfs/qemu/patches"
BR2_DOWNLOAD_FORCE_CHECK_HASHES=y
BR2_SYSTEM_DHCP="eth0"
BR2_ROOTFS_POST_IMAGE_SCRIPT="board/hrootfs/qemu/post-image.sh"
BR2_ROOTFS_POST_SCRIPT_ARGS="$(BR2_DEFCONFIG)"
BR2_ENABLE_LOCALE_PURGE=y
BR2_ENABLE_LOCALE_WHITELIST="C en_US zh_CN"
BR2_GENERATE_LOCALE="C en_US zh_CN"
BR2_SYSTEM_ENABLE_NLS=y
BR2_TARGET_TZ_INFO=y
BR2_TARGET_TZ_ZONELIST="default"
BR2_TARGET_LOCALTIME="Asia/Shanghai"
BR2_ROOTFS_OVERLAY="board/hrootfs/qemu/overlay"
BR2_LINUX_KERNEL=y
BR2_LINUX_KERNEL_CUSTOM_VERSION=y
BR2_LINUX_KERNEL_CUSTOM_VERSION_VALUE="6.18.7"
BR2_LINUX_KERNEL_USE_ARCH_DEFAULT_CONFIG=y
BR2_TARGET_ROOTFS_EXT2=y
BR2_TARGET_ROOTFS_EXT2_SIZE="100M"
BR2_TARGET_OPENSBI=y
BR2_TARGET_OPENSBI_CUSTOM_VERSION=y
BR2_TARGET_OPENSBI_CUSTOM_VERSION_VALUE="1.6"
BR2_TARGET_OPENSBI_PLAT="generic"
BR2_TARGET_GENERIC_HOSTNAME="HRootFs"
BR2_TARGET_GENERIC_ISSUE="Welcome to HRootFs"
BR2_PACKAGE_HOST_QEMU=y
BR2_PACKAGE_HOST_QEMU_SYSTEM_MODE=y
BR2_PACKAGE_KEXEC=y
BR2_PACKAGE_KEXEC_ZLIB=y
BR2_PACKAGE_HASHTOOL=y
BR2_PACKAGE_HOST_HASHTOOL=y
BR2_PACKAGE_HED25519SIGN=y
BR2_PACKAGE_HOST_HED25519SIGN=y
BR2_PACKAGE_HCRCTABLEGENERATE=y
BR2_PACKAGE_HOST_HCRCTABLEGENERATE=y
BR2_PACKAGE_HGZIP=y
BR2_PACKAGE_HOST_HGZIP=y
BR2_PACKAGE_HLZ4=y
BR2_PACKAGE_HOST_HLZ4=y
BR2_PACKAGE_HMINI_MCS51=y
BR2_PACKAGE_HOST_HMINI_MCS51=y
BR2_PACKAGE_HMINI_RV32IMA=y
BR2_PACKAGE_HOST_HMINI_RV32IMA=y
BR2_PACKAGE_HMINI_RV32IMAV2=y
BR2_PACKAGE_HOST_HMINI_RV32IMAV2=y
BR2_PACKAGE_DUMPPLCDLL=y
BR2_PACKAGE_HOST_DUMPPLCDLL=y
BR2_PACKAGE_OPENSSL=y
BR2_PACKAGE_HHTTP=y
BR2_PACKAGE_HOST_HHTTP=y
BR2_PACKAGE_HHTTP_OPENSSL=y
BR2_PACKAGE_HHTTPD=y
BR2_PACKAGE_HOST_HHTTPD=y
BR2_PACKAGE_HHTTPD_OPENSSL=y
BR2_PACKAGE_HSNTP=y
BR2_PACKAGE_HOST_HSNTP=y
BR2_PACKAGE_HSNTPD=y
BR2_PACKAGE_HOST_HSNTPD=y
```

## package/dotfontscan/Config.in
```kconfig
comment "dotfontscan needs a toolchain w/ C++, wchar, threads"
	depends on !BR2_INSTALL_LIBSTDCPP || !BR2_USE_WCHAR || \
		!BR2_TOOLCHAIN_HAS_THREADS

config BR2_PACKAGE_DOTFONTSCAN
	bool "dotfontscan"
	depends on BR2_USE_WCHAR
	depends on BR2_INSTALL_LIBSTDCPP
	depends on BR2_TOOLCHAIN_HAS_THREADS
	select BR2_PACKAGE_FREETYPE
	select BR2_PACKAGE_HOST_DOTFONTSCAN
	help
	  HCppBox dotfontscan

	  https://git.hyhsystem.cn/HEYAHONG/HCppBox
```

## package/dotfontscan/Config.in.host
```kconfig
config BR2_PACKAGE_HOST_DOTFONTSCAN
	bool "host dotfontscan"
	help
	  HCppBox dotfontscan host tool

	  https://git.hyhsystem.cn/HEYAHONG/HCppBox
```

## package/dumpplcdll/Config.in
```kconfig
comment "dumpplcdll needs a toolchain w/ C++, wchar, threads"
	depends on !BR2_INSTALL_LIBSTDCPP || !BR2_USE_WCHAR || \
		!BR2_TOOLCHAIN_HAS_THREADS

config BR2_PACKAGE_DUMPPLCDLL
	bool "dumpplcdll"
	depends on BR2_USE_WCHAR
	depends on BR2_INSTALL_LIBSTDCPP
	depends on BR2_TOOLCHAIN_HAS_THREADS
	select BR2_PACKAGE_HOST_DUMPPLCDLL
	help
	  HCppBox dumpplcdll

	  https://git.hyhsystem.cn/HEYAHONG/HCppBox
```

## package/dumpplcdll/Config.in.host
```kconfig
config BR2_PACKAGE_HOST_DUMPPLCDLL
	bool "host dumpplcdll"
	help
	  HCppBox dumpplcdll host tool

	  https://git.hyhsystem.cn/HEYAHONG/HCppBox
```

## package/hcrctablegenerate/Config.in
```kconfig
comment "hcrctablegenerate needs a toolchain w/ C++, wchar, threads"
	depends on !BR2_INSTALL_LIBSTDCPP || !BR2_USE_WCHAR || \
		!BR2_TOOLCHAIN_HAS_THREADS

config BR2_PACKAGE_HCRCTABLEGENERATE
	bool "hcrctablegenerate"
	depends on BR2_USE_WCHAR
	depends on BR2_INSTALL_LIBSTDCPP
	depends on BR2_TOOLCHAIN_HAS_THREADS
	select BR2_PACKAGE_HOST_HCRCTABLEGENERATE
	help
	  HCppBox hcrctablegenerate

	  https://git.hyhsystem.cn/HEYAHONG/HCppBox
```

## package/hcrctablegenerate/Config.in.host
```kconfig
config BR2_PACKAGE_HOST_HCRCTABLEGENERATE
	bool "host hcrctablegenerate"
	help
	  HCppBox hcrctablegenerate host tool

	  https://git.hyhsystem.cn/HEYAHONG/HCppBox
```

## package/hguitools/Config.in.host
```kconfig
config BR2_PACKAGE_HOST_HGUITOOLS
	bool "host hguitools"
	help
	  HCppBox hguitools host tool

	  This tool requires wxWidgets 3.2 or later on the build host.

	  https://git.hyhsystem.cn/HEYAHONG/HCppBox
```

## package/hgzip/Config.in
```kconfig
comment "hgzip needs a toolchain w/ C++, wchar, threads"
	depends on !BR2_INSTALL_LIBSTDCPP || !BR2_USE_WCHAR || \
		!BR2_TOOLCHAIN_HAS_THREADS

config BR2_PACKAGE_HGZIP
	bool "hgzip"
	depends on BR2_USE_WCHAR
	depends on BR2_INSTALL_LIBSTDCPP
	depends on BR2_TOOLCHAIN_HAS_THREADS
	select BR2_PACKAGE_HOST_HGZIP
	help
	  HCppBox hgzip

	  https://git.hyhsystem.cn/HEYAHONG/HCppBox
```

## package/hgzip/Config.in.host
```kconfig
config BR2_PACKAGE_HOST_HGZIP
	bool "host hgzip"
	help
	  HCppBox hgzip host tool

	  https://git.hyhsystem.cn/HEYAHONG/HCppBox
```

## package/hhttp/Config.in
```kconfig
comment "hhttp needs a toolchain w/ C++, wchar, threads"
	depends on !BR2_INSTALL_LIBSTDCPP || !BR2_USE_WCHAR || \
		!BR2_TOOLCHAIN_HAS_THREADS

config BR2_PACKAGE_HHTTP
	bool "hhttp"
	depends on BR2_USE_WCHAR
	depends on BR2_INSTALL_LIBSTDCPP
	depends on BR2_TOOLCHAIN_HAS_THREADS
	select BR2_PACKAGE_HOST_HHTTP
	help
	  HCppBox hhttp

	  https://git.hyhsystem.cn/HEYAHONG/HCppBox

if BR2_PACKAGE_HHTTP

config BR2_PACKAGE_HHTTP_OPENSSL
	bool "openssl support"
	default y
	select BR2_PACKAGE_OPENSSL
	help
	  Enable HTTPS support using OpenSSL.

endif
```

## package/hhttp/Config.in.host
```kconfig
config BR2_PACKAGE_HOST_HHTTP
	bool "host hhttp"
	help
	  HCppBox hhttp host tool

	  https://git.hyhsystem.cn/HEYAHONG/HCppBox
```

## package/hhttpd/Config.in
```kconfig
comment "hhttpd needs a toolchain w/ C++, wchar, dynamic library, threads"
	depends on !BR2_INSTALL_LIBSTDCPP || !BR2_USE_WCHAR || \
		BR2_STATIC_LIBS || !BR2_TOOLCHAIN_HAS_THREADS

config BR2_PACKAGE_HHTTPD
	bool "hhttpd"
	depends on !BR2_STATIC_LIBS
	depends on BR2_USE_WCHAR
	depends on BR2_INSTALL_LIBSTDCPP
	depends on BR2_TOOLCHAIN_HAS_THREADS
	select BR2_PACKAGE_HOST_HHTTPD
	help
	  HCppBox hhttpd

	  https://git.hyhsystem.cn/HEYAHONG/HCppBox

if BR2_PACKAGE_HHTTPD

config BR2_PACKAGE_HHTTPD_OPENSSL
	bool "openssl support"
	default y
	select BR2_PACKAGE_OPENSSL
	help
	  Enable HTTPS support using OpenSSL.

endif
```

## package/hhttpd/Config.in.host
```kconfig
config BR2_PACKAGE_HOST_HHTTPD
	bool "host hhttpd"
	help
	  HCppBox hhttpd host tool

	  https://git.hyhsystem.cn/HEYAHONG/HCppBox
```

## package/hlz4/Config.in
```kconfig
comment "hlz4 needs a toolchain w/ C++, wchar, threads"
	depends on !BR2_INSTALL_LIBSTDCPP || !BR2_USE_WCHAR || \
		!BR2_TOOLCHAIN_HAS_THREADS

config BR2_PACKAGE_HLZ4
	bool "hlz4"
	depends on BR2_USE_WCHAR
	depends on BR2_INSTALL_LIBSTDCPP
	depends on BR2_TOOLCHAIN_HAS_THREADS
	select BR2_PACKAGE_HOST_HLZ4
	help
	  HCppBox hlz4

	  https://git.hyhsystem.cn/HEYAHONG/HCppBox
```

## package/hlz4/Config.in.host
```kconfig
config BR2_PACKAGE_HOST_HLZ4
	bool "host hlz4"
	help
	  HCppBox hlz4 host tool

	  https://git.hyhsystem.cn/HEYAHONG/HCppBox
```

## package/hmini-mcs51/Config.in
```kconfig
comment "hmini-mcs51 needs a toolchain w/ C++, wchar, threads"
	depends on !BR2_INSTALL_LIBSTDCPP || !BR2_USE_WCHAR || \
		!BR2_TOOLCHAIN_HAS_THREADS

config BR2_PACKAGE_HMINI_MCS51
	bool "hmini-mcs51"
	depends on BR2_USE_WCHAR
	depends on BR2_INSTALL_LIBSTDCPP
	depends on BR2_TOOLCHAIN_HAS_THREADS
	select BR2_PACKAGE_HOST_HMINI_MCS51
	help
	  HCppBox hmini-mcs51

	  https://git.hyhsystem.cn/HEYAHONG/HCppBox
```

## package/hmini-mcs51/Config.in.host
```kconfig
config BR2_PACKAGE_HOST_HMINI_MCS51
	bool "host hmini-mcs51"
	help
	  HCppBox hmini-mcs51 host tool

	  https://git.hyhsystem.cn/HEYAHONG/HCppBox
```

## package/hmini-rv32ima/Config.in
```kconfig
comment "hmini-rv32ima needs a toolchain w/ C++, wchar, threads"
	depends on !BR2_INSTALL_LIBSTDCPP || !BR2_USE_WCHAR || \
		!BR2_TOOLCHAIN_HAS_THREADS

config BR2_PACKAGE_HMINI_RV32IMA
	bool "hmini-rv32ima"
	depends on BR2_USE_WCHAR
	depends on BR2_INSTALL_LIBSTDCPP
	depends on BR2_TOOLCHAIN_HAS_THREADS
	select BR2_PACKAGE_HOST_HMINI_RV32IMA
	help
	  HCppBox hmini-rv32ima

	  https://git.hyhsystem.cn/HEYAHONG/HCppBox
```

## package/hmini-rv32ima/Config.in.host
```kconfig
config BR2_PACKAGE_HOST_HMINI_RV32IMA
	bool "host hmini-rv32ima"
	help
	  HCppBox hmini-rv32ima host tool

	  https://git.hyhsystem.cn/HEYAHONG/HCppBox
```

## package/hmini-rv32imav2/Config.in
```kconfig
comment "hmini-rv32imav2 needs a toolchain w/ C++, wchar, dynamic library, threads"
	depends on !BR2_INSTALL_LIBSTDCPP || !BR2_USE_WCHAR || \
		BR2_STATIC_LIBS || !BR2_TOOLCHAIN_HAS_THREADS

config BR2_PACKAGE_HMINI_RV32IMAV2
	bool "hmini-rv32imav2"
	depends on !BR2_STATIC_LIBS
	depends on BR2_USE_WCHAR
	depends on BR2_INSTALL_LIBSTDCPP
	depends on BR2_TOOLCHAIN_HAS_THREADS
	select BR2_PACKAGE_HOST_HMINI_RV32IMAV2
	help
	  HCppBox hmini-rv32imav2

	  https://git.hyhsystem.cn/HEYAHONG/HCppBox
```

## package/hmini-rv32imav2/Config.in.host
```kconfig
config BR2_PACKAGE_HOST_HMINI_RV32IMAV2
	bool "host hmini-rv32imav2"
	help
	  HCppBox hmini-rv32imav2 host tool

	  https://git.hyhsystem.cn/HEYAHONG/HCppBox
```

## package/hmodbushelper/Config.in.host
```kconfig
config BR2_PACKAGE_HOST_HMODBUSHELPER
	bool "host hmodbushelper"
	help
	  HCppBox hmodbushelper host tool

	  This tool requires wxWidgets 3.2 or later and libserialport on the build host.

	  https://git.hyhsystem.cn/HEYAHONG/HCppBox
```
